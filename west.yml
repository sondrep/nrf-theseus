## west.yml
```yaml
# The west manifest file (west.yml) for nRF Theseus.
#
# The per-workspace west configuration file, .west/config, specifies the
# location of this manifest file like this:
#
#     [manifest]
#     path = nrf-theseus
#
# See the west documentation for more information:
# https://docs.zephyrproject.org/latest/develop/west/manifest.html

manifest:
  version: "0.13"

  # "remotes" is a list of locations where git repositories are cloned
  # and fetched from. Keep sorted alphabetically by name.
  remotes:
    - name: eivindj
      url-base: https://github.com/eivindj-nordic
    - name: anhmolt
      url-base: https://github.com/anhmolt
    - name: apache
      url-base: https://github.com/apache
    - name: ARM-software
      url-base: https://github.com/ARM-software
    - name: FreeRTOS
      url-base: https://github.com/FreeRTOS
    - name: intel
      url-base: https://github.com/intel
    - name: mcu-tools
      url-base: https://github.com/mcu-tools
    - name: ncs
      url-base: https://github.com/nrfconnect
    - name: nordicsemi
      url-base: https://github.com/NordicSemiconductor
    - name: picolibc
      url-base: https://github.com/picolibc

  # Projects pull from this remote unless they override it.
  defaults:
    remote: nordicsemi

  # "projects" is a list of git repositories that make up the source tree.
  # Keep entries sorted alphabetically by name for easy diffing.
  projects:
    - name: cmsis
      remote: ARM-software
      repo-path: CMSIS_6
      path: cmsis
      revision: v6.1.0

    - name: FreeRTOS-Kernel
      remote: FreeRTOS
      repo-path: FreeRTOS-Kernel
      path: FreeRTOS-Kernel
      revision: V11.1.0

    - name: mcuboot
      remote: mcu-tools
      repo-path: mcuboot
      path: mcuboot
      revision: v2.4.0

    - name: mynewt-core
      remote: apache
      repo-path: mynewt-core
      path: mynewt-core
      # No tag matches NimBLE 1.9.0's expectations as of 2026.06.15
      # (the compatible state is over 100+ commits past mynewt_1_14_0_tag on master, with no release tag there).
      # Pinned to this known-good commit for a reproducible build.
      revision: fb5c45cc345e11cca474f751136f9eebbf1d143c

    - name: newt
      remote: apache
      repo-path: mynewt-newt
      path: mynewt-newt
      revision: mynewt_1_14_0_tag

    - name: nimble
      remote: apache
      repo-path: mynewt-nimble
      path: mynewt-nimble
      revision: nimble_1_9_0_tag

    - name: nrfx
      remote: nordicsemi
      repo-path: nrfx
      path: nrfx
      revision: v4.3.0

    - name: nrfxlib
      remote: eivindj
      repo-path: sdk-nrfxlib
      path: nrfxlib
      # NCS fork: no clean upstream tag, pinned to a known-good commit.
      revision: bc861864c2cd9097ce2fad5fab8ec0819be43b7a

    - name: picolibc
      remote: picolibc
      repo-path: picolibc
      path: picolibc
      revision: "1.8.6"

    - name: tinycrypt
      remote: intel
      repo-path: tinycrypt
      path: tinycrypt
      revision: v0.2.8

  self:
    path: nrf-theseus
    west-commands: scripts/west-commands.yml
```
